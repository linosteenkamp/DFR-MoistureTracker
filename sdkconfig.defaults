## sdkconfig.defaults
```kconfig
CONFIG_NVS_FLASH=y
CONFIG_ESP_NETIF=y
CONFIG_WIFI_PROV_ENABLED=y
CONFIG_WIFI_PROV_TRANSPORT_SOFTAP=y

# Route console output to the built-in USB-Serial-JTAG so logs appear over USB
CONFIG_ESP_CONSOLE_UART_DEFAULT=n
CONFIG_ESP_CONSOLE_USB_SERIAL_JTAG=y
```

## sdkconfig.defaults.zigbee
```kconfig
# Base console-over-USB (mirrors sdkconfig.defaults)
CONFIG_NVS_FLASH=y
CONFIG_ESP_CONSOLE_UART_DEFAULT=n
CONFIG_ESP_CONSOLE_USB_SERIAL_JTAG=y

# Zigbee end-device on the native 802.15.4 radio
CONFIG_ZB_ENABLED=y
CONFIG_ZB_ZED=y
CONFIG_ZB_RADIO_NATIVE=y

# Power management — REQUIRED for esp_zb_sleep_now() to actually light-sleep.
# Without these two, esp_zb_sleep_enable(true) only *permits* sleep; the CPU
# stays at full clock and the radio stays on (~100 mA continuous → ~12 h on a
# 1200 mAh cell). esp_pm_configure(light_sleep_enable=true) is called from the
# Zigbee signal handler ONLY after a successful join — enabling it during the
# BDB steering scan starves the IDLE task and trips the Task WDT (see PR #2).
CONFIG_PM_ENABLE=y
CONFIG_FREERTOS_USE_TICKLESS_IDLE=y
# Power the MAC+baseband down during light sleep (radio off between parent polls).
CONFIG_ESP_PHY_MAC_BB_PD=y

# Flash size (board is 4MB; explicit because this env's sdkconfig_defaults
# replaces the base defaults and would otherwise fall back to 2MB)
CONFIG_ESPTOOLPY_FLASHSIZE_4MB=y

# Custom partition table (adds zb_storage / zb_fct)
CONFIG_PARTITION_TABLE_CUSTOM=y
CONFIG_PARTITION_TABLE_CUSTOM_FILENAME="partitions.csv"

# OTA: roll back to the previous app if a freshly-flashed image fails its
# self-check (see ota_client / main.c rollback gate).
CONFIG_BOOTLOADER_APP_ROLLBACK_ENABLE=y
```
